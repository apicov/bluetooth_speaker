## components/dancefloor_sync/Kconfig
```kconfig
menu "Dancefloor audio output"

    choice DANCEFLOOR_OUTPUT_CHANNELS
        prompt "Which channels this unit plays"
        default DANCEFLOOR_OUT_STEREO
        help
            Every unit receives the same stereo stream. This picks what this
            unit's own speaker does with it, so a floor can be laid out as a
            stereo pair -- one box left, one box right -- rather than every box
            playing everything.

            A selected channel is written to BOTH I2S slots, not left in one
            with the other muted. Which slot an amp latches is a hardware strap
            (the MAX98357A's SD pin, a PCM5102A's mono wiring), so muting the
            other one is a coin flip between the intended channel and silence.
            Duplicating is right whatever the amp does, and loses no loudness.

            Build-time, per image. A left box and a right box are two builds:
            check the OUTPUT line at boot to see which one a board is running.

            Lives in this component, not in each project's own Kconfig, because
            audio_out.h is what reads these symbols and audio_out.h lives here.
            It was declared separately in the satellite's Kconfig and the S3
            hub's, and the classic hub -- which built the same shared header --
            declared it nowhere at all, so it took the #else branch and played
            stereo by omission rather than by choice. A shared header cannot
            require each project to remember to declare what it consumes; the
            declaration belongs beside the code that reads it.

        config DANCEFLOOR_OUT_STEREO
            bool "Stereo -- both channels, as received"

        config DANCEFLOOR_OUT_LEFT
            bool "Left channel only"

        config DANCEFLOOR_OUT_RIGHT
            bool "Right channel only"

        config DANCEFLOOR_OUT_MONO
            bool "Mono -- (L+R)/2"
            help
                For a single speaker that should not lose whatever is panned
                hard, which is what a one-box mix does if it takes one channel.

    endchoice

endmenu

menu "Dancefloor radio pairing"

    comment "These four are one link seen from both ends -- the hub is the AP,"
    comment "the satellite is the STA. A mismatch is not a degraded link, it is"
    comment "no link, and it reports as the wrong thing. Declared here so the"
    comment "two firmwares cannot disagree."

    config DANCEFLOOR_AP_SSID
        string "SoftAP SSID"
        default "dancefloor"
        help
            The hub creates this network; every satellite joins it.

            Was a #define in hub_s3/main/streamer.c and another in
            satellite/main/sat.h, with nothing checking they agreed. They are one
            value -- an SSID only means anything if both ends say the same thing
            -- so it is declared once, here, beside the component both firmwares
            already require.

    config DANCEFLOOR_AP_PASS
        string "SoftAP password (WPA2-PSK)"
        default "dancefloor"
        help
            Ignored on both units when DANCEFLOOR_AP_OPEN is set.

            WPA2-PSK requires 8 to 63 characters. Kconfig cannot check that, and
            neither end reports a too-short password as a password problem: the
            AP simply fails to come up with the credentials it was given, and the
            satellite reports a failure to associate.

            This is a closed floor with a shared secret in a public git
            repository. It keeps a passer-by off the network; it is not a
            security boundary, and nothing here should be treated as one.

    config DANCEFLOOR_AP_OPEN
        bool "Run the SoftAP with no password (diagnostic)"
        default n
        help
            Isolates the WPA2 handshake. If clients associate with this on but
            not off, the problem is the security config; if they fail either way,
            the AP itself is not coming up properly and the credentials are a red
            herring.

            BOTH UNITS MUST MATCH. This used to be declared once per project,
            and the satellite's prompt said "must match the hub" while nothing
            checked it -- two independently-maintained defaults that happened to
            agree. A mismatch surfaces as a station that will not associate,
            which wifi_start_ap()'s own note records presenting as "incorrect
            password rather than anything that points at the real cause".

    config DANCEFLOOR_DISABLE_PMF
        bool "Disable Protected Management Frames (see help)"
        default y
        help
            PMF's Secure Association teardown is disconnecting our own
            satellite. Measured on this hardware: the AP starts an SA Query, the
            satellite fails to answer six attempts, and the AP disassociates it
            with reason 209 -- 1.7 s off the network, twice in the first 65
            seconds of a run, and the satellite did not even notice.

            Both units must have this set the same way, since the capability is
            negotiated. pmf_cfg.capable cannot be used to opt out: it is
            deprecated in IDF 6 and forced true internally.

            What is given up is protection of management frames against spoofed
            deauth and disassoc. Data stays encrypted under WPA2-PSK and the
            password is unchanged. Turn it back on if you would rather have that
            protection than a stable link, and watch sta-left in the hub's
            HEALTH line to see what it costs.

endmenu

menu "Dancefloor audio transport (FEC)"

    comment "Audio, the volume level and the analysis frames all go to the hub's"
    comment "client list, one sendto per satellite -- ACKed and retried by the link"
    comment "layer, and airtime scales with speaker count. Loss recovery is XOR"
    comment "parity across a group of packets; see the help below for the two"
    comment "schemes that came before it and what each one measured."

    config DANCEFLOOR_AUDIO_FEC_K
        int "XOR parity group size K (0 disables)"
        default 4
        range 0 8
        help
          One parity datagram per K audio packets, which recovers any single
          packet lost out of that group -- whole, header included. 0 turns it
          off; 2..8 are the valid group sizes and anything else is refused by a
          build assertion rather than half-configured.

          THE COST IS 1/K, AND THAT IS THE ENTIRE POINT. K=4 is 25% more audio
          bytes and 25% more audio datagrams; K=8 is 12.5% of each. Read those
          against the 73% the scheme this replaces cost permanently, and against
          the ~0.2-0.3% on-air loss any of it exists to repair.

          WHY NOT PIGGYBACKED, WHICH IS WHAT WAS HERE BEFORE. This setting used
          to be DANCEFLOOR_AUDIO_FEC_DEPTH: 0-4 copies of previous payloads
          attached to each packet's tail. It was correct code and it lost:

            mcast fec 0 (13:02, 13:30)   hub tx-fail 0
            mcast fec 1 (14:23)          hub tx-fail 92 / 365 s
            mcast fec 1 (17:52)          hub tx-fail 10-58 AUDIO per 20 s

          The mechanism was airtime. A depth-1 packet is pinned at the full
          1472-byte MTU instead of ~851 B -- 73% more airtime for audio, at the
          fixed 6 Mbps group rate with no aggregation -- and the hub's static TX
          buffers could not absorb it: 4-6% of the audio discarded at the socket
          to repair 0.2-0.3% lost on the air. It could not even repair that
          fully. A whole copy of an ~825-byte payload does not fit beside it, so
          what arrived was ~75% and the satellite padded the rest, logged as
          `fec 5 (29 ms short, 5 err)` -- ~5.8 ms of silence per recovery and a
          decode error on every one. Over a five-hour soak fec-trunc reached
          889,439 against ~890,000 packets: every copy, always.

          CAPPING THE PAYLOAD SO A COPY FITS WAS TRIED ON 2026-08-13 AND TOOK
          THE FLOOR DOWN. It binds on every packet, so each payload becomes two
          datagrams, and the doubled AUDIO packet rate both exhausted the
          transmit buffers (`tx-fail 370 (312 audio)` in one 20 s window) and
          doubled the timeline slew, which is TIMELINE_SLEW_US per audio packet.
          Phase ran to +271 ms and the satellites re-anchored every few seconds.

          Parity is not that. The parity datagram carries no play_at, never
          enters streamer_send_sbc(), and does not advance the timeline -- so it
          raises the datagram rate by 1/K and the slew by nothing at all. The
          audio packets keep their natural ~851 B and nothing is truncated, so a
          recovery is whole rather than three-quarters of one.

          A/B ON 2026-08-24, matched 46-minute windows on the same channel: the
          old FEC 1 and FEC 0 were both flawless -- zero gaps, zero refusals,
          zero starvation either way, and the old scheme fired 9 times in 5
          hours. A CLEAN CHANNEL CANNOT TELL THESE APART. Test under contention
          or do not bother: a large download on a nearby machine, not associated
          to the hub's AP, degrades playback audibly within seconds and is the
          only condition in which any of this earns its overhead.

          WHY K DEFAULTS TO 4 RATHER THAN 8. Parity for a group can only be sent
          after the group's last packet, so a receiver that wants to use it must
          hold the packets behind a hole until the parity lands -- worst case
          (K-2) packet times, ~20 ms each. At K=4 that is 40 ms against a 350 ms
          hub lead (LEAD_US), a 350 ms target ring depth (RING_TARGET_MS) and a
          125 ms anchor floor (ANCHOR_MIN_LEAD_US), so a repaired packet still
          reaches the ring with ~310 ms of lead in hand. K=8 halves the overhead
          but holds 120 ms, which eats a third of the ring and starts showing up
          in ring-low. The hold also costs the satellite (K-1) packet buffers of
          RAM, which is why the ceiling is 8 and not more.

          Both ends must agree on K: group membership is seq % K, derived rather
          than negotiated. They cannot disagree silently -- the parity carries
          its own base_seq and count, and a receiver that reconstructed a
          different group refuses the recovery and counts fec-bad.

endmenu

menu "Dancefloor diagnostics"

    config DANCEFLOOR_LOG_PERIOD_S
        int "Seconds between periodic status lines"
        default 20
        range 5 300
        help
            How often the recurring status lines print: the hub's ring/phase
            line, the satellite's buffer/phase line, the SBC link summary, the
            visualiser's frame counts, and the TSF comparison.

            Logging only. Every servo, window and estimator keeps its own
            cadence -- the 5 s loops still run at 5 s and still see every
            sample, they simply do not narrate each pass -- so changing this
            cannot change behaviour.

            At 5 s the two boards emitted a line every 0.8 s between them, most
            of it identical to the line before. Anything eventful -- a retune, a
            splice, a track boundary, a decode error, dropped audio -- is logged
            when it happens and is not on this clock. Two of the lines above
            also print immediately on a bad window regardless of this setting,
            because waiting to hear about a fault is how faults get missed.

            Lives here because both firmwares require this component, and
            because Kconfig symbols are global in ESP-IDF: the LED component
            reads it without needing to depend on the sync protocol.

    config DANCEFLOOR_SBC_LINK_SPI_HZ
        int "Bridge -> hub SPI clock (Hz)"
        default 5000000
        range 100000 40000000
        help
            SCK frequency the bt_bridge master drives on the one-way SPI link to
            the hub. The slave is clocked by the master, so only the bridge
            build's value is on the wire; the hub build carries a copy only so
            its startup log prints the right number.

            1 MHz is where the link starts -- 20x the UART's 50 kB/s, against a
            measured ~42 kB/s stream. The breadboard jumpers this lives on were
            the UART's ceiling at 500 kbaud, and SPI adds a clock line to the
            bundle, so expect signal integrity, not the protocol, to be the
            limit. If the sbc_in crc/hdr counters move at one speed, drop this
            and reflash the BRIDGE; the hub need not match unless its log should.

            Default is 5 MHz: the 2048-payload frame (2060 bytes on the wire,
            sized for the codec's bitpool 250) is clean at 5 MHz but fails at
            10 MHz on these jumpers -- the hub's sbc_in reports short/gaps while
            the bridge stays clean -- and at 1 MHz the 16.5 ms transfer would
            eat most of the ~20 ms A2DP cadence. The smaller 1036-byte frame
            (1024 payload) was clean at 10 MHz, should the ceiling ever drop.

            Lives here (rather than the bridge's own Kconfig) because the symbol
            is shared through this component and both ends print it.

    config DANCEFLOOR_WIFI_LOGS
        bool "Forward logs + telemetry over WiFi to a collector"
        default n
        help
          Ships every ESP_LOG line (MSG_LOG) and a structured HEALTH snapshot
          (MSG_HEALTH) over the sync UDP socket to a laptop collector that has
          joined the AP, for bench analysis. The hub relays its own and every
          satellite's logs to whichever laptop sent MSG_LOG_SUB.

          Off in production. The receive path must never block on a network
          send -- a blocking log write in rx_task starves the UDP mailbox and
          causes the very loss it was logging (satellite/main/main.c:286) --
          so the shipper is a low-priority task fed by a non-blocking,
          drop-on-full queue, and the whole feature compiles out when this is
          unset: zero airtime, zero feedback-loop risk, no wifi_log symbols.

          Enable for bench in the role's sdkconfig.defaults. The bridge is not
          affected: it has no WiFi, and its logs reach the collector over USB.

endmenu
```
