## components/dancefloor_leds/Kconfig
```kconfig
menu "Dancefloor LEDs"

    config DANCEFLOOR_ENABLE_VISUALISER
        bool "Enable LED visualiser (FFT + beat detection + strip)"
        default y
        help
            Turn off to test whether the FFT and LED refresh are stealing time
            from audio -- it is the heaviest thing sharing core 1 with playback.

    config DANCEFLOOR_LED_GPIO
        int "WS2812 data GPIO"
        default 18
        depends on DANCEFLOOR_ENABLE_VISUALISER
        help
            Driven as SPI2 MOSI through the GPIO matrix. Needs a 74AHCT125 level
            shifter: 3.3 V data into a 5 V WS2812 is unreliable without one.

    config DANCEFLOOR_LED_COUNT
        int "Number of LEDs"
        default 8
        depends on DANCEFLOOR_ENABLE_VISUALISER
        help
            Total pixels on the one data line, so chained 8-LED sticks add up:
            four of them is 32, not 8.

            8 is the bring-up figure and small enough to run off the devkit's
            5 V rail. The real strips are 1-2 m and need their own supply.

    choice DANCEFLOOR_LED_TYPE
        prompt "Strip model"
        default DANCEFLOOR_LED_TYPE_WS2812
        depends on DANCEFLOOR_ENABLE_VISUALISER
        help
            Wire order differs between models. Getting this wrong swaps colours
            rather than failing, so it looks like a bug in the patterns.

        config DANCEFLOOR_LED_TYPE_WS2812
            bool "WS2812 / WS2812B (5 V, GRB)"

        config DANCEFLOOR_LED_TYPE_WS2811
            bool "WS2811 (12 V, BRG as wired here, 1 IC per 3 LEDs)"

        config DANCEFLOOR_LED_TYPE_SK6812
            bool "SK6812 RGBW (5 V, GRBW)"
    endchoice

    config DANCEFLOOR_LED_BRIGHTNESS
        int "Brightness cap (percent)"
        default 10
        range 1 100
        depends on DANCEFLOOR_ENABLE_VISUALISER
        help
            Scales every pixel before it is sent. LEDs are the largest single
            load in the power budget -- ~150 pixels at full white is ~45 W --
            and eyes are dark-adapted outdoors at night, so a low figure looks
            no dimmer than a high one and reclaims most of that.

            40 was the original design figure and was too bright on the bench.
            Below about 10 the 8-bit colour resolution starts to show: the
            brightest component becomes 25, so hue steps get visibly coarse and
            the dim tail of the beat envelope quantises to black.

    config DANCEFLOOR_ENABLE_LED_MARKER
        bool "LED sync marker (bench instrument)"
        default n
        help
            Flashes once per second of master-clock time, on every unit at the
            same instant. Put two boards side by side: if the onboard LEDs blink
            together the whole chain agrees, and if one lags it is obvious with
            no console and no wiring.

            The same LED also carries whether the unit is on the floor at all,
            because "dark" was previously two completely different answers
            wearing one face -- a satellite that never found the hub looked
            exactly like a joined one waiting for music. Three states now:

              dark        not joined -- booting, or dropped off the AP
              solid lit   joined, nothing playing
              flashing    audio is being drawn, one flash per master second

            Only the flash is worth comparing between units; the other two are
            per-unit facts. A satellite drives the level through
            visualiser_marker_set_link() from its wifi events. The hub is the AP
            and has nothing to join, so it never calls it and its LED keeps the
            original two states: dark, or flashing.

            It shows something nothing else does. Every existing measurement
            covers the AUDIO path -- the audio marker, AUDIO SYNC, TRACK
            DIVERGENCE. Between playback and the pixels sit the analysis stream
            buffer, the FFT, the detector and the render, and none of that is
            measured anywhere. The strips could be visibly out of step with the
            speakers perfectly aligned and nothing would report it.

            The second boundary comes from due_us, which is derived from the
            scheduled instant the audio carries, so every unit crosses it on the
            same block with nothing sent between them.

            Same discipline as the audio marker: nothing corrects on it, so this
            changes no behaviour. It costs one GPIO write per analysis block.

    config DANCEFLOOR_LED_MARKER_GPIO
        int "GPIO for the LED sync marker"
        default 2
        range 0 33
        depends on DANCEFLOOR_ENABLE_LED_MARKER
        help
            Which pin to flash. 2 is the default because it is the onboard LED
            on the most common ESP32 boards, but this varies and there is no way
            to detect it -- so if the LED stays dark while the log says the
            marker fired, this is the setting to change.

            Boards seen in the wild:

              GPIO 2   DOIT ESP32 DEVKIT V1, NodeMCU-32S, most WROOM-32 clones
              GPIO 5   WEMOS/LOLIN D32, some TTGO
              GPIO 16  a few ESP32-CAM style boards
              GPIO 22  some Heltec boards. This used to say 22 was the hub's
                       SBC UART TX and so satellite-only; it is not any more.
                       The link is one-way and the hub names no TX pin.
              none     official Espressif ESP32-DevKitC has only a power LED
              none     XIAO ESP32-S3 in practice. Its onboard LED is documented
                       as GPIO 21 and did not light when pointed at. Unresolved,
                       and the pin may simply differ by board revision. It is
                       also active low, which used to be a second reason to
                       avoid it and is no longer one -- see
                       DANCEFLOOR_LED_MARKER_ACTIVE_LOW below. Wire an external
                       LED to pad D1, which is GPIO 2 and so already this
                       default.

            With no usable onboard LED, wire one to any free pin through a
            resistor, or point this at a pin you can watch on a scope. Taken
            here: I2S (25, 26, 27), the strip (18), the markers (4, 21). The
            hub is an S3 with its own numbering -- see its Kconfig for the four
            SBC SPI pins.

            The range stops at 33 because GPIO 34-39 on the ESP32 are
            input-only and cannot drive anything. That bound is an ESP32 fact
            and not an S3 one, where it costs the XIAO's D6 (GPIO 43) -- but
            D1, D2 and D5 are 2, 3 and 6, so something is always reachable.

            The eye resolves maybe 10-20 ms and a 240 fps phone camera about
            4 ms, so this answers "are they together" rather than "by how much"
            -- the numbers are in AUDIO SYNC and TRACK DIVERGENCE.

    config DANCEFLOOR_LED_MARKER_ACTIVE_LOW
        bool "The LED sync marker is wired to VCC (active low)"
        default y
        depends on DANCEFLOOR_ENABLE_LED_MARKER
        help
            Which way round the LED is wired, which decides which level lights
            it. Set this and the driver writes 0 to light and 1 to darken.

              y  LED anode to 3V3, cathode through a resistor to the pin. The
                 pin SINKS the current, so a LOW level lights it. This is how
                 every board on this floor is wired, and it is what an onboard
                 LED almost always is.

              n  LED anode from the pin through a resistor, cathode to ground.
                 The pin SOURCES the current and a HIGH level lights it.

            IT MATTERS MORE THAN IT LOOKS, because getting it wrong does not
            produce a dark LED -- it produces an INVERTED one, lit for the 960
            ms between flashes and dark for the 40 ms of the flash itself. On a
            satellite it also inverts the two idle states, so an unjoined unit
            glows and a joined one sits dark -- which is the one reading that
            makes a healthy floor look broken. The flash reads as a working
            marker until you notice every unit is showing one
            gap per second rather than one flash, and two units disagreeing
            about this look exactly like a sync fault.

            The default is y because this floor is wired that way. A unit whose
            LED is wired the other way needs this set to n, and BOTH ends of a
            side-by-side comparison must agree or the comparison is nonsense.

            This changes the sense of the pin only. It does not change when the
            marker fires, and nothing corrects on it either way.

    config DANCEFLOOR_LED_PATTERN
        string "Pattern to start with"
        default "pulse"
        help
            Which pattern the strip runs from boot. Must match a name from
            pattern_by_name() -- run `tools/pattern_lab --list` to see them.
            An unknown name logs a warning and leaves the first pattern
            running, so a typo costs a line in the log rather than a dark floor.

            "pulse" follows onsets across all four bands, which suits music
            whose transients are broadband.

            "boom" follows the lowest band alone, 43-129 Hz, and is meant for
            forró: the mallet stroke on the zabumba's big head, with the
            triangle and the accordion deliberately not wanted. Try both against
            a recording in pattern_lab before deciding -- where the two disagree
            on the same track, one of them is wrong about the music, and which
            one depends entirely on what is playing.


    choice DANCEFLOOR_LED_HOP
        prompt "Analysis hop (samples advanced between windows)"
        default DANCEFLOOR_LED_HOP_512
        depends on DANCEFLOOR_ENABLE_VISUALISER
        help
            How far the analysis advances between one window and the next. The
            WINDOW stays 1024 samples whatever this is set to -- that is what
            fixes the 43 Hz bin width and the band edges, and changing it would
            be a retune. This sets only how often a window is taken, and so how
            often a frame is produced.

            512 is the default: 50% overlap, 86 frames a second, and what
            ordinary onset-detection algorithms assume. 1024 is no overlap --
            each window begins where the last one ended -- which is what shipped
            before overlap existed.

            The detector has been retuned for 512 -- see docs/tuning-corpus.md,
            which is the corpus, the commands and the ladders. The outcome was
            that no constant needed to move: both flux floors and BEAT_HIST are
            the same numbers at 512 as at 1024, now measured over 206 recordings
            at both hops rather than ten at one.

            What is NOT affected, and needs no measurement: both refractory
            periods, which are already in microseconds, and both threshold_k
            values -- scaling flux scales the mean and the standard deviation
            identically, so those decisions are unchanged.

            What this setting DOES change, and cannot be tuned away: which
            strokes fire. Flux is a frame-to-frame difference, so at 512 it is
            differenced across 11.6 ms of audio and at 1024 across 23.2 ms, and
            those are different measurements of the same music. Measured over
            the ten reference tracks, only 64% of the booms at 1024 have a boom
            at 512 within one window of them, against 91% for a comparable
            change made at a fixed hop. Expect roughly a third of the strokes to
            move when this setting does. That is a property of the hop and not a
            tuning error; no floor value reduces it.

            So 1024 is not a safer fallback, it is a different choice, and it is
            the one now carrying constants confirmed against a corpus at 512.

            A choice rather than a number because the hop must divide the window
            and be a power of two. Anything else fails the build in
            analysis_config.h; this way it cannot be selected at all.

            On LED_SOURCE_REMOTE this configures no analysis -- such a unit runs
            none. It DECLARES what the unit sending it frames is doing, and it
            has to match, because it sizes the frame queue. A mismatch is
            detected and logged at runtime.

        config DANCEFLOOR_LED_HOP_1024
            bool "1024 -- no overlap, the last fully tuned setting"

        config DANCEFLOOR_LED_HOP_512
            bool "512 -- 50% overlap, 86 frames/s"

        config DANCEFLOOR_LED_HOP_256
            bool "256 -- 75% overlap, 172 frames/s"
    endchoice

    config DANCEFLOOR_ML
        bool "Run the pluggable analysers on this unit"
        default n
        depends on DANCEFLOOR_ENABLE_VISUALISER
        help
            Whether this unit runs the registered analysers beside the FFT, and
            therefore whether the lane, its task and its buffers are built at
            all. Off means the analysers are compiled by nobody and Frame::ml
            stays empty; the strip still lights from the FFT exactly as before.

            THIS REPLACED A CHOICE, and the difference matters. There used to be
            DANCEFLOOR_ML_SOURCE -- local or remote -- because a unit that could
            not hold a model could be GIVEN one's results by the hub. Nothing is
            given any more: analysers read the spectrum every unit already has,
            so a unit either runs them or does without them, and this is that
            question.

            Default n so that turning it on is a decision each build makes.
            The hub in particular must stay off: it gave up ~25 kB of internal
            SRAM to stop running this lane, which is the pool its WiFi TX buffers
            come from, and hub_s3/sdkconfig.defaults records what that bought.

    config DANCEFLOOR_ML_TFLM
        bool "Build the TensorFlow Lite Micro analyser base"
        default n
        depends on DANCEFLOOR_ML && SPIRAM
        help
            Compiles analyser_tflm.cpp, which removes the boilerplate every
            TFLM-backed analyser would otherwise repeat: the arena, the schema
            check, the interpreter, and failing cleanly enough that a unit which
            cannot run the model still lights up from its neighbours.

            Off by default because esp-tflite-micro is a large component and
            nothing in this tree has a model yet. Turning this on also means
            uncommenting the dependency in
            components/dancefloor_leds/idf_component.yml -- the exact lines are
            there.

            DEPENDS ON SPIRAM, WHICH IS A STATEMENT ABOUT THE ARENA rather than
            about a part number. ml_arena.c prefers PSRAM and falls back to
            internal SRAM, and the fallback is the dangerous path: a 64 kB arena
            does not fail at the allocation on a board without PSRAM, it fails an
            hour later as an audio dropout nobody connects to the model. A
            classic-ESP32 satellite is already holding an 80 kB ring in the same
            pool.

            So the guard is here rather than on the target. That keeps the rule
            the rest of this component follows -- gate on what a unit can do, not
            on what chip it is -- and it means a future part with PSRAM is
            allowed without editing this line. The practical effect today is that
            models run on the XIAO S3 satellite and nowhere else.

            Note it does NOT gate DANCEFLOOR_ML. The shipped analysers need no
            arena at all, so a board without PSRAM can still run those; it just
            cannot host a model.

            Read the note at the top of analyser_tflm.hpp before converting a
            model. The short version: quantise it to int8. On a floor where more
            than one unit runs the model locally that is a CORRECTNESS
            requirement, not a size optimisation -- the hub is an LX7, a
            satellite is an LX6, esp-nn picks different kernels per target, and
            two units disagreeing is the failure that takes an evening to find.

    config DANCEFLOOR_ML_ARENA_KB
        int "Tensor arena, in kB"
        default 64
        range 1 4096
        depends on DANCEFLOOR_ML_TFLM
        help
            Working memory for the interpreter. Ask for too much once, read the
            "N of M B used" line the analyser prints at startup, then set this
            from N.

            WHERE it comes from is decided at runtime and reported: PSRAM if the
            board has it, internal SRAM otherwise. hub_s3 enables PSRAM with
            CONFIG_SPIRAM_USE_CAPS_ALLOC, so ordinary malloc() never returns it
            and the ring, the DMA buffers, the frame queue and every task stack
            stay internal with the timing they were measured with.

            The arena WAS the only thing that could reach PSRAM. It is not any
            more: CONFIG_SPIRAM_TRY_ALLOCATE_WIFI_LWIP now lets the WiFi and
            lwIP buffers prefer it too, because internal SRAM on that board had
            reached a 1520-byte watermark and a 1700-byte WiFi TX buffer was
            failing to allocate. See docs/hub-s3-gap-list.md S2.4.

            That is not a competition for space -- 8 MB against an arena capped
            at 4096 kB and a WiFi ceiling near 105 kB -- but it does mean the
            arena is no longer alone on the PSRAM bus or in the cache. TFLM
            streams its arena, so it is the heavier user of both by far; WiFi
            moves perhaps 135 kB/s. If inference and the radio ever appear to
            interact, `vis: ml:`, `vis: cost:`, `sbc_in max gap` and the hub's
            `tx-fail` are the four numbers that would show it, and enabling the
            two one at a time is what makes the answer attributable.

            A classic-ESP32 satellite has no PSRAM at all, so an arena of any
            size comes out of internal SRAM and does not fail at the allocation
            -- it fails an hour later as an audio dropout. That is why
            DANCEFLOOR_ML_TFLM depends on SPIRAM: there is no longer a "let some
            other unit decide" option to fall back to, so the board either has
            somewhere to put an arena or it does not run models at all.

    config DANCEFLOOR_ML_SLOTS
        int "Pluggable analysers that may run at once"
        default 2
        range 1 8
        depends on DANCEFLOOR_ENABLE_VISUALISER
        help
            How many analysers can run beside the FFT, and therefore how many
            results every frame carries. One slot per registered analyser, at
            the same index, so a pattern reading f.ml[i] always gets analyser i
            whatever else is or is not enabled.

            It costs RAM in the frame queue and the cost is not trivial: a
            result is 40 bytes and the queue holds 32 * (1024 / hop) frames, so
            each slot is 2.5 kB at hop 512 and 5 kB at hop 256. A classic-ESP32
            satellite analysing locally has about 52 kB free, so this is worth
            setting to what is actually used.

            2 is the default because the case this was built for is one fast
            analyser beside one slow one -- a per-hop detector and a model with
            a second of context, which is precisely the pair that cannot share
            a lane.

            This MUST match the fallback in analysis_config.h, which is what
            tools/pattern_lab and the unit tests compile with -- they see no
            sdkconfig.h at all, and a struct that differed in size between the
            laptop and the board would make every figure measured on the laptop
            describe a different pipeline. Raising it here means raising it
            there.

    choice DANCEFLOOR_LED_SOURCE
        prompt "Where this unit's analysis frames come from"
        default DANCEFLOOR_LED_SOURCE_LOCAL
        depends on DANCEFLOOR_ENABLE_VISUALISER
        help
            Frames are drawn at the instant they name, so a unit can be given
            them by another unit instead of computing its own and still stay in
            step with it.

            Mixing the two across a floor is intended, not a hazard: a unit on
            LOCAL runs its own analysis and can therefore run a different
            algorithm. What is guaranteed is narrower than "every strip agrees"
            -- it is that units taking frames from the same source render
            identically.

            An UNINTENDED mismatch is still the expensive bug, so the live
            source is printed at startup and carried in the HEALTH line.

        config DANCEFLOOR_LED_SOURCE_LOCAL
            bool "Local -- this unit analyses the audio it holds"
            help
                What every unit did before frames could travel. Costs an FFT
                and two detectors per frame, and gives the pattern the full
                spectrum.

        config DANCEFLOOR_LED_SOURCE_REMOTE
            bool "Remote -- this unit is given frames by the hub"
            help
                No FFT and no detectors run here; the analysis task is not
                even started. The strip follows the sending unit exactly,
                whatever algorithm it runs, because there is only one copy of
                the decision.

                Frame::mag is not available under this option -- it is 512
                floats and does not travel. Patterns using spec[] work either
                way.

    endchoice

endmenu
```
