## hub/main/Kconfig.projbuild
```kconfig
menu "Dancefloor hub"

    comment "I2S output -- to this unit's own DAC (this chip is the MASTER)"

    config DANCEFLOOR_I2S_LRCK_PIN
        int "I2S LRCK (WS) GPIO"
        default 27

    config DANCEFLOOR_I2S_BCK_PIN
        int "I2S BCK GPIO"
        default 26

    config DANCEFLOOR_I2S_DATA_PIN
        int "I2S DATA GPIO"
        default 25

    config DANCEFLOOR_WIFI_CHANNEL
        int "SoftAP channel (1-13)"
        default 11
        help
            Pinned rather than driver-chosen: Bluetooth's adaptive frequency
            hopping avoids a WiFi interferer far more effectively when it sits on
            a fixed, known slice of the band. Costs nothing.

    config DANCEFLOOR_WIFI_PHY_RATE_MBPS
        int "Pin the PHY rate in Mbps (6, 12, 24; 0 = rate adaptation)"
        default 6
        help
            Diagnostic. Pinning was mandatory while audio went out by multicast,
            because group-addressed frames fall back to the 1 Mbps basic rate and
            the stream physically did not fit. Audio is unicast now and rate
            adaptation works properly, so 0 is very likely the right value --
            it is left at 6 only because the system was measured working there
            and the change wants a listening test.

            Note this pins ALL transmission on the interface, unicast included,
            so any non-zero value disables rate adaptation entirely.

    config DANCEFLOOR_AP_OPEN
        bool "Run the SoftAP with no password (diagnostic)"
        default n
        help
            Isolates the WPA2 handshake. If clients associate with this on but
            not off, the problem is the security config; if they fail either way,
            the AP itself is not coming up properly and the credentials are a red
            herring. Satellites must be built to match.

    comment "Sync measurement"

    config DANCEFLOOR_MARKER_GPIO
        int "GPIO pulsed when playback crosses a marker instant"
        default 4
        help
            Every unit pulses this when it plays the sample landing on a
            master-clock marker. Wire a satellite's marker pin to this board's
            monitor pin and the hub reports the gap directly -- the sync error
            measured on audio rather than on clock estimates.

    config DANCEFLOOR_MONITOR_GPIO
        int "GPIO watching a satellite's marker pulse"
        default 21
        help
            Input. Wire the SATELLITE's marker GPIO here, plus a common ground.
            Must differ from the marker GPIO.

    config DANCEFLOOR_RETUNE_BENCH_S
        int "Bench only: force a same-rate retune every N seconds (0 = off)"
        default 0
        help
            Retunes the DAC clock to the rate it is ALREADY set to, on a timer.
            A no-op as far as the audio is concerned, so anything it costs in
            sync is the cost of retuning itself -- the channel down, the DMA
            buffer discarded -- with no rate change and no drift in the way.

            Enable it on ONE unit only, so the other stays a reference. Leave at
            0 for anything you intend to listen to.

    comment "LEDs are under 'Dancefloor LEDs' -- shared with the satellite"

endmenu
```

## hub_s3/main/Kconfig.projbuild
```kconfig
menu "Dancefloor hub"

    comment "SBC link in -- SPI slave, from the bt_bridge chip"

    config DANCEFLOOR_SBC_SPI_SCK_PIN
        int "SPI clock in, from the bridge"
        default 44
        help
            Four wires and a common ground, one way: the bridge is the master
            and this chip only ever receives, so there is no MISO.

            The bus is SPI3. SPI2 belongs to the LED strip, which reserves a
            whole bus to drive one WS2812 pin.

            44 is D7 on the XIAO ESP32-S3, the pad silkscreened RX, and the pin
            this link used to arrive on as a UART. The classic-ESP32 hub used
            23, which does not exist on this part: the S3's GPIOs are 0-21 and
            26-48, so 22 to 25 are simply absent. 26-32 exist but are wired to
            the SPI flash, and 33-37 to the octal PSRAM.

    config DANCEFLOOR_SBC_SPI_MOSI_PIN
        int "SPI data in, from the bridge"
        default 6

    config DANCEFLOOR_SBC_SPI_CS_PIN
        int "SPI chip select in, from the bridge"
        default 5
        help
            CS is the framing. One assertion is one packet, which is why this
            link carries no sync bytes and the receiver runs no resync scan.

            5 is D4, and it was DANCEFLOOR_MONITOR_GPIO. Taking it ends the
            marker/monitor instrument, which needs both 4 and 5 -- see the help
            on DANCEFLOOR_ENABLE_MARKER. It was the cheapest of the four pads
            that could have gone: the instrument is off by default, needs a wire
            between two boards that a deployed floor cannot have, and nothing
            corrects on it.

    config DANCEFLOOR_SBC_SPI_HS_PIN
        int "Handshake out, telling the bridge a buffer is armed"
        default 3
        help
            Output. Raised while a transaction is queued and dropped for the
            duration of a transfer; the bridge waits for it before clocking.

            Not optional. ESP-IDF's spi_slave loses any transfer that arrives
            with nothing queued -- the peripheral has nowhere to put it -- so
            without this the link drops frames at random and neither end can
            tell that from corruption.

            3 is D2. It is also the S3's JTAG_SEL strapping pin, which is inert
            unless the STRAP_JTAG_SEL eFuse is burned; the handshake is put here
            rather than a bridge-driven signal so that nothing external is
            driving a strapping pin while this board boots.

    comment "I2S output -- to this unit's own DAC (this chip is the MASTER)"

    config DANCEFLOOR_I2S_LRCK_PIN
        int "I2S LRCK (WS) GPIO"
        default 27

    config DANCEFLOOR_I2S_BCK_PIN
        int "I2S BCK GPIO"
        default 26

    config DANCEFLOOR_I2S_DATA_PIN
        int "I2S DATA GPIO"
        default 25

    choice DANCEFLOOR_OUTPUT_CHANNELS
        prompt "Which channels this unit plays"
        default DANCEFLOOR_OUT_STEREO
        help
            Every unit receives the same stereo stream. This picks what this
            unit's own speaker does with it, so a floor can be laid out as a
            stereo pair -- one box left, one box right -- rather than every box
            playing everything.

            A selected channel is written to BOTH I2S slots, not left in one
            with the other muted. Which slot an amp latches is a hardware strap
            (the MAX98357A's SD pin, a PCM5102A's mono wiring), so muting the
            other one is a coin flip between the intended channel and silence.
            Duplicating is right whatever the amp does, and loses no loudness.

            Build-time, per image. A left box and a right box are two builds:
            check the OUTPUT line at boot to see which one a board is running.

        config DANCEFLOOR_OUT_STEREO
            bool "Stereo -- both channels, as received"

        config DANCEFLOOR_OUT_LEFT
            bool "Left channel only"

        config DANCEFLOOR_OUT_RIGHT
            bool "Right channel only"

        config DANCEFLOOR_OUT_MONO
            bool "Mono -- (L+R)/2"
            help
                For a single speaker that should not lose whatever is panned
                hard, which is what a one-box mix does if it takes one channel.

    endchoice

    config DANCEFLOOR_WIFI_CHANNEL
        int "SoftAP channel (1-13)"
        default 11
        help
            Pinned rather than driver-chosen: Bluetooth's adaptive frequency
            hopping avoids a WiFi interferer far more effectively when it sits on
            a fixed, known slice of the band. Costs nothing.

    config DANCEFLOOR_WIFI_PHY_RATE_MBPS
        int "Pin the PHY rate in Mbps (6, 12, 24; 0 = rate adaptation)"
        default 6
        help
            Diagnostic. Pinning was mandatory while audio went out by multicast,
            because group-addressed frames fall back to the 1 Mbps basic rate and
            the stream physically did not fit. Audio is unicast now and rate
            adaptation works properly, so 0 is very likely the right value --
            it is left at 6 only because the system was measured working there
            and the change wants a listening test.

            Note this pins ALL transmission on the interface, unicast included,
            so any non-zero value disables rate adaptation entirely.

    config DANCEFLOOR_PUBLISH_FRAMES
        bool "Broadcast analysis frames to satellites (LED_SOURCE_REMOTE)"
        default y
        depends on DANCEFLOOR_ENABLE_VISUALISER
        help
            Whether the hub unicasts its per-track analysis frames (MSG_FRAME,
            ~5 kB/s per listener on top of the audio) to every registered
            satellite. Leave on when any satellite is built LED_SOURCE_REMOTE
            and renders from these; turn off when every satellite is
            LED_SOURCE_LOCAL and analyses its own audio, to recover that ~5 kB/s
            of downlink airtime per satellite.

            Airtime scales with satellite count under unicast fan-out, so on a
            large floor of local-source satellites this is free capacity. The
            hub's own local strip is unaffected either way: this gates the
            broadcast, not the analysis.

    config DANCEFLOOR_PUBLISH_ML
        bool "Send analyser results to satellites (ML_SOURCE_REMOTE)"
        default y
        depends on DANCEFLOOR_ENABLE_VISUALISER
        help
            Whether the hub unicasts its pluggable analysers' results (MSG_ML)
            to every registered satellite. Leave on when any satellite is built
            ML_SOURCE_REMOTE; turn off when every satellite runs its own.

            Cost depends entirely on which analysers are enabled, and the two
            lanes are not comparable. A SLOW analyser reporting once a second is
            36 bytes a second and beneath notice. A FAST one publishes at the
            analysis rate -- 86 a second at hop 512 -- which is about what the
            MSG_FRAME stream itself costs, so turning one on roughly doubles the
            per-listener downlink this hub already pays.

            Separate from DANCEFLOOR_PUBLISH_FRAMES because the two answer
            different questions and a floor may well want one without the other:
            satellites computing their own FFT frames while being given a model
            only the hub can hold is exactly the arrangement ML_SOURCE_REMOTE
            exists for.

    config DANCEFLOOR_AP_OPEN
        bool "Run the SoftAP with no password (diagnostic)"
        default n
        help
            Isolates the WPA2 handshake. If clients associate with this on but
            not off, the problem is the security config; if they fail either way,
            the AP itself is not coming up properly and the credentials are a red
            herring. Satellites must be built to match.

    comment "Sync measurement"

    config DANCEFLOOR_ENABLE_MARKER
        bool "Sync marker GPIO (bench instrument)"
        default n
        help
            Pulses a pin when playback reaches a tagged sample, and watches a
            satellite's pin doing the same, so the hub can report how far apart
            the two units' AUDIO actually are -- measured at the speaker rather
            than inferred from clock estimates. It is the only measurement that
            sees what happens between samples_played and the sound, so it stays
            the ground truth while it is attached.

            It needs a wire and a common ground between two boards, so a
            deployed floor cannot have it: satellites reach the hub over WiFi
            and nothing else. Off by default for that reason.

            Nothing corrects on it. Every servo and every splice closes through
            play_at and the phase queue, so enabling or disabling this changes
            no behaviour -- only whether the measurement exists. A correction
            loop closed through an instrument that is absent in deployment
            would be tuned to a configuration nobody ships.

            The cost when enabled is a 200 us busy-wait in the playback task
            every ~2 s, on each unit. Identical on both, so it cancels for sync
            purposes, but it buys nothing once the wire is off.

            Track-boundary divergence is reported over WiFi regardless, and
            covers every satellite rather than the wired one.

    config DANCEFLOOR_MARKER_GPIO
        int "GPIO pulsed when playback crosses a marker instant"
        default 4
        depends on DANCEFLOOR_ENABLE_MARKER
        help
            Every unit pulses this when it plays the sample landing on a
            master-clock marker. Wire a satellite's marker pin to this board's
            monitor pin and the hub reports the gap directly -- the sync error
            measured on audio rather than on clock estimates.

    config DANCEFLOOR_MONITOR_GPIO
        int "GPIO watching a satellite's marker pulse"
        default 5
        depends on DANCEFLOOR_ENABLE_MARKER
        help
            Input. Wire the SATELLITE's marker GPIO here, plus a common ground.
            Must differ from the marker GPIO.

            5 is D4 on the XIAO ESP32-S3, against the classic hub's 21. 21
            exists on this part but is the board's onboard LED and is not
            brought out to a pad.

            This default lives here rather than in sdkconfig.defaults, and that
            is not a style choice. The symbol depends on DANCEFLOOR_ENABLE_MARKER,
            which is off, so it is invisible when sdkconfig is generated and a
            value for it in sdkconfig.defaults is silently discarded -- turning
            the marker on later would then quietly hand the monitor input to the
            onboard LED. Kconfig is the only place the number survives.

    config DANCEFLOOR_DISABLE_PMF
        bool "Disable Protected Management Frames (see help)"
        default y
        help
            PMF's Secure Association teardown is disconnecting our own
            satellite. Measured on this hardware: the AP starts an SA Query, the
            satellite fails to answer six attempts, and the AP disassociates it
            with reason 209 -- 1.7 s off the network, twice in the first 65
            seconds of a run, and the satellite did not even notice.

            Both units must have this set the same way, since the capability is
            negotiated. pmf_cfg.capable cannot be used to opt out: it is
            deprecated in IDF 6 and forced true internally.

            What is given up is protection of management frames against spoofed
            deauth and disassoc. Data stays encrypted under WPA2-PSK and the
            password is unchanged. Turn it back on if you would rather have that
            protection than a stable link, and watch sta-left in the hub's
            HEALTH line to see what it costs.

    config DANCEFLOOR_RETUNE_BENCH_S
        int "Bench only: force a same-rate retune every N seconds (0 = off)"
        default 0
        help
            Retunes the DAC clock to the rate it is ALREADY set to, on a timer.
            A no-op as far as the audio is concerned, so anything it costs in
            sync is the cost of retuning itself -- the channel down, the DMA
            buffer discarded -- with no rate change and no drift in the way.

            Enable it on ONE unit only, so the other stays a reference. Leave at
            0 for anything you intend to listen to.

    comment "LEDs are under 'Dancefloor LEDs' -- shared with the satellite"

endmenu
```
